## boards/shields/nice_view_custom/Kconfig.shield
```kconfig
# Copyright (c) 2022 The ZMK Contributors
# SPDX-License-Identifier: MIT

config SHIELD_NICE_VIEW_CUSTOM
    def_bool $(shields_list_contains,nice_view_custom)
    select ZMK_BEHAVIORS if ZMK_DISPLAY

config ZMK_BEHAVIOR_ART_CONTROL
    def_bool $(dt_compat_enabled,zmk_behavior_art_control)

config CUSTOM_ART_SURPRISE_ME
    bool "Include the single newest/featured art piece"
    default y
    help
      If enabled, the one art piece currently featured by the repository
      will be automatically included in your slideshow. This lets you
      sample new art without adding everything. You can still disable
      it with its own flag if you don't like it.
```
