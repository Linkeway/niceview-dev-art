## boards/shields/nice_view_custom/Kconfig.defconfig
```kconfig
# Copyright (c) 2023 The ZMK Contributors
# SPDX-License-Identifier: MIT

if SHIELD_NICE_VIEW_CUSTOM

config CUSTOM_ANIMATION_SPEED
    int "Total duration in milliseconds for animation to take"
    default 300000

config CUSTOM_ART_VIM
    bool "Show vim art"
    default n

config CUSTOM_ART_CHILL
    bool "Show chill art"
    default n

config CUSTOM_ART_LGTM
    bool "Show lgtm art"
    default y if CUSTOM_ART_SURPRISE_ME
    default n

config CUSTOM_ART_CPP
    bool "Show cpp art"
    default n

config CUSTOM_ART_HAMMERBEAM1
    bool "Show hammerbeam1 art"
    default n

config CUSTOM_ART_HAMMERBEAM2
    bool "Show hammerbeam2 art"
    default n

config CUSTOM_ART_HAMMERBEAM3
    bool "Show hammerbeam3 art"
    default n

config CUSTOM_ART_HAMMERBEAM4
    bool "Show hammerbeam4 art"
    default n

config CUSTOM_ART_HAMMERBEAM5
    bool "Show hammerbeam5 art"
    default n

config CUSTOM_ART_HAMMERBEAM6
    bool "Show hammerbeam6 art"
    default n

config CUSTOM_ART_HAMMERBEAM7
    bool "Show hammerbeam7 art"
    default n

config CUSTOM_ART_HAMMERBEAM8
    bool "Show hammerbeam8 art"
    default n

config CUSTOM_ART_HAMMERBEAM9
    bool "Show hammerbeam9 art"
    default n

config CUSTOM_ART_HAMMERBEAM10
    bool "Show hammerbeam10 art"
    default n

config CUSTOM_ART_HAMMERBEAM11
    bool "Show hammerbeam11 art"
    default n

config CUSTOM_ART_HAMMERBEAM12
    bool "Show hammerbeam12 art"
    default n

config CUSTOM_ART_HAMMERBEAM13
    bool "Show hammerbeam13 art"
    default n

config CUSTOM_ART_HAMMERBEAM14
    bool "Show hammerbeam14 art"
    default n

config CUSTOM_ART_HAMMERBEAM15
    bool "Show hammerbeam15 art"
    default n

config CUSTOM_ART_HAMMERBEAM16
    bool "Show hammerbeam16 art"
    default n

config CUSTOM_ART_HAMMERBEAM17
    bool "Show hammerbeam17 art"
    default n

config CUSTOM_ART_HAMMERBEAM18
    bool "Show hammerbeam18 art"
    default n

config CUSTOM_ART_HAMMERBEAM19
    bool "Show hammerbeam19 art"
    default n

config CUSTOM_ART_HAMMERBEAM20
    bool "Show hammerbeam20 art"
    default n

config CUSTOM_ART_HAMMERBEAM21
    bool "Show hammerbeam21 art"
    default n

config CUSTOM_ART_HAMMERBEAM22
    bool "Show hammerbeam22 art"
    default n

config CUSTOM_ART_HAMMERBEAM23
    bool "Show hammerbeam23 art"
    default n

config CUSTOM_ART_HAMMERBEAM24
    bool "Show hammerbeam24 art"
    default n

config CUSTOM_ART_HAMMERBEAM25
    bool "Show hammerbeam25 art"
    default n

config CUSTOM_ART_HAMMERBEAM26
    bool "Show hammerbeam26 art"
    default n

config CUSTOM_ART_HAMMERBEAM27
    bool "Show hammerbeam27 art"
    default n

config CUSTOM_ART_HAMMERBEAM28
    bool "Show hammerbeam28 art"
    default n

config CUSTOM_ART_HAMMERBEAM29
    bool "Show hammerbeam29 art"
    default n

config CUSTOM_ART_HAMMERBEAM30
    bool "Show hammerbeam30 art"
    default n

config LV_Z_VDB_SIZE
    default 100

config LV_DPI_DEF
    default 161

config LV_Z_BITS_PER_PIXEL
    default 1

choice LV_COLOR_DEPTH
    default LV_COLOR_DEPTH_1
endchoice

choice ZMK_DISPLAY_WORK_QUEUE
    default ZMK_DISPLAY_WORK_QUEUE_DEDICATED
endchoice

choice ZMK_DISPLAY_STATUS_SCREEN
    default ZMK_DISPLAY_STATUS_SCREEN_CUSTOM
endchoice

config LV_Z_MEM_POOL_SIZE
    default 4096 if ZMK_DISPLAY_STATUS_SCREEN_CUSTOM

config ZMK_DISPLAY_STATUS_SCREEN_CUSTOM
    imply NICE_VIEW_WIDGET_STATUS

config NICE_VIEW_WIDGET_STATUS
    bool "Custom nice!view status widget"
    select LV_FONT_MONTSERRAT_16
    select LV_USE_IMG
    select LV_USE_CANVAS
    select LV_USE_ANIMIMG 
    select LV_USE_ANIMATION

config NICE_VIEW_WIDGET_INVERTED
    bool "Invert custom status widget colors"

if !ZMK_SPLIT || ZMK_SPLIT_ROLE_CENTRAL

config NICE_VIEW_WIDGET_STATUS
    select LV_FONT_MONTSERRAT_18
    select LV_FONT_MONTSERRAT_14
    select LV_FONT_UNSCII_8
    select ZMK_WPM

endif # !ZMK_SPLIT || ZMK_SPLIT_ROLE_CENTRAL

config ZMK_DISPLAY_STATUS_SCREEN_BUILT_IN
    select LV_FONT_MONTSERRAT_26

endif # SHIELD_NICE_VIEW
```
